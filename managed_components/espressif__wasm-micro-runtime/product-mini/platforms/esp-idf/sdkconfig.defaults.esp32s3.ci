## sdkconfig.defaults.esp32c5
```kconfig
# Target: ESP32-C5 (dual-band Wi-Fi 6 + BLE single-chip board).
# Mirrors the C6 overlay; the chips differ on radio (C5 adds 5 GHz) and
# 802.15.4 (C5 omits) but the firmware-side knobs we care about are the
# same shape: 4 MB flash, classic WAMR, native Wi-Fi + BT, no USB OTG.
CONFIG_IDF_TARGET="esp32c5"

# Flash size - keep at 4 MB; partitions.csv is sized accordingly.
CONFIG_ESPTOOLPY_FLASHSIZE_4MB=y

# Partition table - custom CSV with single WASM slot
CONFIG_PARTITION_TABLE_CUSTOM=y
CONFIG_PARTITION_TABLE_CUSTOM_FILENAME="partitions.csv"

# WAMR: classic interp + mini loader keep flash/RAM use tight on the C5.
CONFIG_WAMR_INTERP_CLASSIC=y
# CONFIG_WAMR_INTERP_FAST is not set
CONFIG_WAMR_INTERP_LOADER_MINI=y
# CONFIG_WAMR_INTERP_LOADER_NORMAL is not set

# Move WiFi/PHY hot paths from IRAM to flash (frees ~15-25 KB DIRAM)
CONFIG_ESP_WIFI_IRAM_OPT=n
CONFIG_ESP_WIFI_EXTRA_IRAM_OPT=n
CONFIG_ESP_WIFI_RX_IRAM_OPT=n
CONFIG_ESP_WIFI_SLP_IRAM_OPT=n
CONFIG_ESP_PHY_IRAM_OPT=n
```

## sdkconfig.defaults.esp32c6
```kconfig
# Target: ESP32-C6
CONFIG_IDF_TARGET="esp32c6"

# Flash size - keep at 4 MB; partitions.csv is sized accordingly.
CONFIG_ESPTOOLPY_FLASHSIZE_4MB=y

# Partition table - custom CSV with single WASM slot
CONFIG_PARTITION_TABLE_CUSTOM=y
CONFIG_PARTITION_TABLE_CUSTOM_FILENAME="partitions.csv"

# WAMR: classic interp + mini loader keep flash/RAM use tight on the C6.
CONFIG_WAMR_INTERP_CLASSIC=y
# CONFIG_WAMR_INTERP_FAST is not set
CONFIG_WAMR_INTERP_LOADER_MINI=y
# CONFIG_WAMR_INTERP_LOADER_NORMAL is not set

# Move WiFi/PHY hot paths from IRAM to flash (frees ~15-25 KB DIRAM)
CONFIG_ESP_WIFI_IRAM_OPT=n
CONFIG_ESP_WIFI_EXTRA_IRAM_OPT=n
CONFIG_ESP_WIFI_RX_IRAM_OPT=n
CONFIG_ESP_WIFI_SLP_IRAM_OPT=n
CONFIG_ESP_PHY_IRAM_OPT=n
```

## sdkconfig.defaults.esp32p4
```kconfig
# Target: ESP32-P4 - knobs common to every supported P4 board.
# The on-board ESP32-C6 provides Wi-Fi and Bluetooth via ESP-Hosted over SDIO;
# its slave firmware is pre-flashed at the factory.
#
# Board-specific bits (flash size, partition table) live in boards/<board>.defaults
# and are selected at configure time via an argfile, e.g.:
#     idf.py @boards/waveshare_lcd_4b.cfg set-target esp32p4
#     idf.py @boards/dfr1172_firebeetle.cfg set-target esp32p4
# A bare `set-target esp32p4` with no board is rejected by the top-level
# CMakeLists.txt (see CONFIG_WENDY_P4_BOARD_NAME).
CONFIG_IDF_TARGET="esp32p4"

# Both currently supported boards ship with early-revision P4 silicon (v1.0).
# The default IDF build targets v3.1+, which is mutually incompatible - opt into
# the pre-v3 support path and require at least v1.0. On rev 3.0+ silicon, drop
# these two knobs and let the IDF defaults stand.
CONFIG_ESP32P4_SELECTS_REV_LESS_V3=y
CONFIG_ESP32P4_REV_MIN_100=y

# --- PSRAM (32 MB HEX @ 200 MHz, integrated in the ESP32-P4R32 / NRW32) ---
CONFIG_SPIRAM=y
CONFIG_SPIRAM_MODE_HEX=y
CONFIG_SPIRAM_SPEED_200M=y
CONFIG_SPIRAM_BOOT_INIT=y
CONFIG_SPIRAM_USE_MALLOC=y
CONFIG_SPIRAM_TRY_ALLOCATE_WIFI_LWIP=y
# Anything smaller than this stays in internal SRAM (latency-sensitive),
# anything larger may land in PSRAM. 16 KiB matches Espressif's guidance.
CONFIG_SPIRAM_MALLOC_ALWAYSINTERNAL=16384
# Power PSRAM from on-chip LDO2 (default for both current board variants).
CONFIG_ESP_LDO_CHAN_PSRAM_DOMAIN=2

# --- ESP-Hosted: Wi-Fi + Bluetooth via on-board C6 over SDIO ---
# Both the FireBeetle 2 and the Waveshare LCD-4B copy Espressif's
# P4-Function-EV-Board SDIO pinout
CONFIG_SLAVE_IDF_TARGET_ESP32C6=y
CONFIG_ESP_HOSTED_CP_TARGET_ESP32C6=y
CONFIG_ESP_HOSTED_P4_DEV_BOARD_FUNC_BOARD=y
CONFIG_ESP_WIFI_REMOTE_LIBRARY_HOSTED=y

# Bluetooth controller lives on the C6 - disable the (non-existent) native
# controller and route NimBLE's HCI through ESP-Hosted's VHCI transport.
CONFIG_BT_CONTROLLER_DISABLED=y
CONFIG_BT_NIMBLE_TRANSPORT_UART=n
CONFIG_ESP_HOSTED_ENABLE_BT_NIMBLE=y
CONFIG_ESP_HOSTED_NIMBLE_HCI_VHCI=y

# ESP-Hosted recommends 1 kHz tick rate for snappier SDIO scheduling.
CONFIG_FREERTOS_HZ=1000

# Wi-Fi remote buffer / aggregation knobs from Espressif's P4+C6 reference.
CONFIG_WIFI_RMT_STATIC_RX_BUFFER_NUM=16
CONFIG_WIFI_RMT_DYNAMIC_RX_BUFFER_NUM=64
CONFIG_WIFI_RMT_DYNAMIC_TX_BUFFER_NUM=64
CONFIG_WIFI_RMT_AMPDU_TX_ENABLED=y
CONFIG_WIFI_RMT_TX_BA_WIN=32
CONFIG_WIFI_RMT_AMPDU_RX_ENABLED=y
CONFIG_WIFI_RMT_RX_BA_WIN=32

# LWIP throughput tuning to match the Wi-Fi pipe.
CONFIG_LWIP_TCP_SND_BUF_DEFAULT=65534
CONFIG_LWIP_TCP_WND_DEFAULT=65534
CONFIG_LWIP_TCP_RECVMBOX_SIZE=64
CONFIG_LWIP_UDP_RECVMBOX_SIZE=64
CONFIG_LWIP_TCPIP_RECVMBOX_SIZE=64
CONFIG_LWIP_TCP_SACK_OUT=y

# --- WAMR runtime: fast interpreter (more code memory, ~2x speed) ---
# Plenty of PSRAM headroom so the larger fast-interp IR is no concern.
# CONFIG_WAMR_INTERP_CLASSIC is not set
CONFIG_WAMR_INTERP_FAST=y
# Use the normal loader so we can load larger / less constrained modules.
# CONFIG_WAMR_INTERP_LOADER_MINI is not set
CONFIG_WAMR_INTERP_LOADER_NORMAL=y

# WAMR pool generously sized since running WASM guests is the entire point:
# 24 MiB out of the 32 MiB PSRAM. Leaves ~8 MiB PSRAM for system-malloc
# fallbacks.
CONFIG_WENDY_WASM_POOL_SIZE=25165824
CONFIG_WENDY_WASM_USE_PSRAM=y

# wendy_net: large socket pool, buffers in PSRAM.
CONFIG_WENDY_NET_MAX_SOCKETS=32
CONFIG_WENDY_NET_MAX_LISTENERS=8
CONFIG_WENDY_NET_ACCEPT_QUEUE_SIZE=4
CONFIG_WENDY_NET_BUFFER_SIZE=1500
CONFIG_WENDY_NET_BUFFERS_IN_PSRAM=y
# Required for EXT_RAM_BSS_ATTR to actually place the buffers in PSRAM.
CONFIG_SPIRAM_ALLOW_BSS_SEG_EXTERNAL_MEMORY=y
# lwIP needs to be able to hand out at least the wendynet pool + a few
# for mDNS / Wi-Fi / system services.
CONFIG_LWIP_MAX_SOCKETS=40
```
