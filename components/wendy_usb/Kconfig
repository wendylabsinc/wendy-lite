## components/wendy_usb/Kconfig
```kconfig
menu "Wendy USB Communication"
    config WENDY_USB_CDC_ENABLED
        bool "Enable USB CDC protocol"
        depends on SOC_USB_OTG_SUPPORTED
        default n
        help
            Host-side TinyUSB CDC channel used to upload WASM
            guests over USB. Requires a SoC with native USB OTG
            (ESP32-S2/S3/P4) and the esp_tinyusb managed
            component. Off by default on every target.

    config WENDY_USB_PROTOCOL_VERSION
        int "USB protocol version"
        default 1

    config WENDY_USB_CHUNK_SIZE
        int "Upload chunk size (bytes)"
        default 4096
endmenu
```

## components/wendy_usj/Kconfig
```kconfig
menu "Wendy wired console and management"
    config WENDY_USJ
        bool "Enable wired console and management"
        depends on SOC_USB_SERIAL_JTAG_SUPPORTED
        default y if SOC_USB_SERIAL_JTAG_SUPPORTED
        help
            Installs the selected serial driver to output logs and accept
            device management through the WendyCom protocol.

    config WENDY_USJ_USE_UART
        bool "Use UART0 through a USB-to-UART bridge"
        depends on WENDY_USJ && SOC_UART_SUPPORTED && ESP_CONSOLE_UART && ESP_CONSOLE_UART_NUM = 0
        default n
        help
            Use a board's UART0 programming bridge for the Wendy console and
            WendyCom at 115200 baud, instead of native USB Serial/JTAG.
            Keep the ESP-IDF console on UART0 for boot and panic diagnostics.
            Wendy's stdio hook takes ownership of ordinary input and output
            after startup, routing logs only when in console mode.

    config WENDY_USJ_UART_TX_GPIO
        int "UART0 TX GPIO"
        depends on WENDY_USJ_USE_UART
        default 58 if IDF_TARGET_ESP32S31
        default -1
        range -1 61

    config WENDY_USJ_UART_RX_GPIO
        int "UART0 RX GPIO"
        depends on WENDY_USJ_USE_UART
        default 59 if IDF_TARGET_ESP32S31
        default -1
        range -1 61

    config WENDY_USJ_TASK_PRIORITY
        int "USJ task priority"
        depends on WENDY_USJ
        default 2
        range 1 24

    choice WENDY_USJ_TASK_CORE_AFFINITY
        prompt "USJ task core affinity"
        depends on WENDY_USJ
        default WENDY_USJ_TASK_CORE_AFFINITY_NO_AFFINITY
        help
            Core affinity of the wendy_usj task.

        config WENDY_USJ_TASK_CORE_AFFINITY_CPU0
            bool "Core 0"
        config WENDY_USJ_TASK_CORE_AFFINITY_CPU1
            bool "Core 1"
            depends on !FREERTOS_UNICORE
        config WENDY_USJ_TASK_CORE_AFFINITY_NO_AFFINITY
            bool "No affinity"
    endchoice

    config WENDY_USJ_TASK_CORE_AFFINITY
        hex
        depends on WENDY_USJ
        default 0x0 if WENDY_USJ_TASK_CORE_AFFINITY_CPU0
        default 0x1 if WENDY_USJ_TASK_CORE_AFFINITY_CPU1
        default FREERTOS_NO_AFFINITY if WENDY_USJ_TASK_CORE_AFFINITY_NO_AFFINITY
endmenu
```

## components/wendy_wasi_shim/Kconfig
```kconfig
menu "Wendy WASI Shim"
    config WENDY_WASI_SHIM
        bool "Enable WASI Preview 1 shim"
        default y
        depends on WENDY_WASM
        help
            Minimal WASI Preview 1 implementation for compatibility
            with wasm32-wasip1 binaries (Rust, etc.).
endmenu
```

## components/wendy_wasm/Kconfig
```kconfig
menu "Wendy WASM Runtime"
    config WENDY_WASM
        bool "Enable the WASM runtime"
        default y if WENDY_CORE_WASM_APP_SUPPORT
        default n
        help
            Build the WAMR-based WASM runtime and the ability to run
            WASM applications. When disabled, all modules exposing a
            WASM API are disabled as well.

    if WENDY_WASM

    config WENDY_WASM_STACK_SIZE
        int "WASM stack size (bytes)"
        default 32768
        help
            Stack size for the WASM runtime execution environment.

    config WENDY_WASM_HEAP_SIZE
        int "WASM heap size (bytes)"
        default 32768
        help
            Heap size available to WASM applications (inside WAMR pool).

    config WENDY_WASM_POOL_SIZE
        int "WAMR memory pool size (bytes)"
        default 180224
        help
            Total pre-allocated pool for the WAMR runtime. This is
            grabbed early in boot before WiFi/BLE consume RAM.
            Must fit linear memory + heap + stack + WAMR overhead.
            ESP32-C6: 176 KB (294 KB total, ~114 KB left for WiFi/BLE).

    config WENDY_WASM_MAX_MEMORY_PAGES
        int "Maximum guest linear memory (64 KiB pages; 0 keeps module limit)"
        range 0 65536
        default 0
        help
            Bound the active guest's linear memory, including memory.grow.
            Select a cap appropriate to the board and application budget.
            Runtime metadata, code and execution stacks are additional memory.
            The bounded profile supports one linear memory. Host-managed heap
            insertion uses conservative headroom inside this same limit.
            Zero preserves the existing policy for SRAM-only devices.

    config WENDY_WASM_USE_PSRAM
        bool "Allocate WASM heap from PSRAM"
        default y if SPIRAM
        help
            When PSRAM is available, allocate the WASM heap from
            external memory to preserve internal SRAM.

    config WENDY_WASM_AOT_XIP
        bool "Map compiled XIP modules directly from the app flash partition"
        default n
        depends on WAMR_ENABLE_AOT
        help
            AOT modules compiled for this exact target ABI with wamrc --xip
            can retain their executable bytes in mapped flash. Interpreter
            modules keep their ordinary writable loader allocation. Measure
            real application compatibility and heap use on the target board.

    config WENDY_WASM_PREFER_RTC_RAM
        bool "Prefer non-DMA RTC RAM for runtime data allocations"
        default n
        depends on ESP_SYSTEM_ALLOW_RTC_FAST_MEM_AS_HEAP && (!WAMR_ENABLE_AOT || WENDY_WASM_AOT_XIP)
        help
            Use the SDK RTC heap before ordinary memory for WAMR allocations
            when a fixed WAMR pool is not configured. RTC RAM supports byte
            access but not DMA. This can preserve main SRAM for Wi-Fi/BLE
            during certificate flights on devices without PSRAM. Falls back
            to the ordinary allocator when an allocation does not fit. This
            is a placement experiment; measure throughput and peak memory.
            With AOT XIP, executable bytes stay in mapped flash; runtime data
            can still use RTC RAM. Executable allocations use the platform's
            separate executable-memory allocator.

    endif
endmenu
```

## components/wendy_wasmkit/Kconfig
```kconfig
menu "WasmKit Runtime"

config WENDY_WASM_STACK_SIZE
    int "WASM execution stack size"
    default 16384
    help
        Stack size allocated for the WASM module execution environment.

config WENDY_WASM_HEAP_SIZE
    int "WASM heap size"
    default 32768
    help
        Heap size available to the WASM module.

config WENDY_WASM_POOL_SIZE
    int "WasmKit memory pool size"
    default 163840
    help
        Total memory pool pre-allocated for the WasmKit runtime, in bytes.
        This is reserved before WiFi/BLE init to guarantee contiguous SRAM.

config WENDY_WASM_USE_PSRAM
    bool "Use PSRAM for WasmKit pool"
    default n
    depends on SPIRAM
    help
        Allocate the WasmKit memory pool from PSRAM instead of internal SRAM.

endmenu
```

## components/wendy_wifi/Kconfig
```kconfig
menu "Wendy WiFi Communication"
    config WENDY_WIFI_ENABLED
        bool "Enable WiFi transport"
        default y
        help
            Connect to WiFi and enable advertisement via mDNS.

    config WENDY_WIFI_TEST_DISABLE_POWER_SAVE
        bool "Investigate station operation without modem power saving"
        depends on WENDY_WIFI_ENABLED
        default n
        help
            Set WIFI_PS_NONE after station startup for controlled lab trials.
            Compare ordinary ACK/disconnect behavior with the default modem
            sleep policy. This may increase radio power consumption; no power
            saving claim is implied. Saved credentials are unchanged.

    config WENDY_WIFI_TEST_PSRAM_THROUGHPUT
        bool "Qualify larger TCP windows on a PSRAM networking board"
        default n
        help
            Opt-in lab profile for ESP32-C5 and ESP32-S3 with required PSRAM.
            Append boards/network_throughput_psram.defaults to the board's
            defaults. The build rejects unsupported targets, missing PSRAM,
            stale window/buffer settings and insufficient internal reserve.
            Defaults alone do not update an existing sdkconfig. This profile
            uses more network memory and needs hardware latency/heap testing
            before being selected for release firmware.

    config WENDY_WIFI_TEST_MAX_11N
        bool "Investigate station ACK loss with an 802.11n protocol limit"
        depends on WENDY_WIFI_ENABLED
        default n
        help
            Limit the station protocol to b/g/n on 2.4GHz and a/n on 5GHz.
            Compare ordinary connection stability against the default HE mode
            on the same lab AP. Saved credentials and TLS are unchanged.

    config WENDY_WIFI_SSID
        string "WiFi SSID"
        depends on WENDY_WIFI_ENABLED
        default ""

    config WENDY_WIFI_PASSWORD
        string "WiFi password"
        depends on WENDY_WIFI_ENABLED
        default ""

endmenu
```

## main/Kconfig.projbuild
```kconfig
menu "Wendy integration fixtures"
    config WENDY_NET_TEST_SENSOR_SERVICE
        bool "Expose real SoC temperature through SensorLink for integration tests"
        default n
        depends on SOC_TEMP_SENSOR_SUPPORTED
        help
            Registers a 1 Hz float32 Celsius channel 42 with an on-demand
            producer. No producer task is created without a subscription.
            This optional fixture does not simulate camera or microphone hardware.
endmenu
```
