## components/wendy_mesh/Kconfig
```kconfig
menu "Wendy signed mesh leaf"
    config WENDY_MESH_LEAF
        bool "Enable experimental signed mesh leaf"
        default n
        depends on WENDY_PKI && WENDY_WIFI_ENABLED && LWIP_IPV6
        depends on (IDF_TARGET_ESP32S3 || IDF_TARGET_ESP32S31) && SPIRAM && !WENDY_WASM && !LWIP_IPV6_FORWARD
        depends on LWIP_HOOK_IP6_ROUTE_CUSTOM
        help
            Experimental endpoint for ESP32-S3 or ESP32-S31 with PSRAM. Connect
            to one same-tenant peer over TLS 1.3, discovered on Wi-Fi or
            explicitly configured. No transit forwarding or legacy fallback.
            Requires fresh signed time and a canonical UUID enrollment.
            Select the lwIP custom IPv6 route hook before enabling this option.

    choice WENDY_MESH_TRANSPORT
        prompt "Mesh carrier"
        depends on WENDY_MESH_LEAF
        default WENDY_MESH_TCP
        help
            All carriers use the same TLS identity, signed routes and replay
            checks. This endpoint maintains one active peer, without transit.
        config WENDY_MESH_TCP
            bool "Wi-Fi TCP"
        config WENDY_MESH_BLE
            bool "BLE L2CAP (Linux router dials this device)"
            depends on WENDY_BLE && BT_NIMBLE_L2CAP_COC_MAX_NUM >= 2
            depends on BT_NIMBLE_MSYS_1_BLOCK_SIZE >= 248
        config WENDY_MESH_ESPNOW
            bool "ESP-NOW (ESP32 peer)"
    endchoice

    config WENDY_MESH_BLE_PSM
        int "Mesh BLE PSM (must differ from WendyCom PSM)"
        depends on WENDY_MESH_BLE
        range 128 255
        default 129

    config WENDY_MESH_ESPNOW_PEER
        string "Peer station MAC address (xx:xx:xx:xx:xx:xx)"
        depends on WENDY_MESH_ESPNOW
        default ""

    config WENDY_MESH_ESPNOW_CHANNEL
        int "ESP-NOW Wi-Fi channel"
        depends on WENDY_MESH_ESPNOW
        range 1 14
        default 1
        help
            Both peers must use this channel. If connected to an access point,
            its channel must match. The radio can run without joining an AP.

    config WENDY_MESH_ESPNOW_SERVER
        bool "Respond to ESP-NOW peer (requires Internet for signed time)"
        depends on WENDY_MESH_ESPNOW
        default n
        help
            Enable on exactly one endpoint. Both endpoints pin each other's
            device UUID. The responder relays nonce-bound timestamp requests
            to its own enrolled timestamp authority before mutual TLS.

    config WENDY_MESH_AUTO_DISCOVER
        bool "Automatically discover same-tenant mesh routers"
        depends on WENDY_MESH_TCP
        default n
        help
            Discover _wendy-net._udp on the local network and try candidates
            in random order. Authenticate the advertised device and tenant
            over mutual TLS at the Lite listener port. Keep a working peer
            until disconnection, then discover again. No peer pin is stored.

    config WENDY_MESH_ROUTER_HOST
        string "Explicit router IP address or hostname"
        depends on WENDY_MESH_TCP && !WENDY_MESH_AUTO_DISCOVER
        default ""

    config WENDY_MESH_ROUTER_DEVICE
        string "Pinned peer device UUID"
        depends on WENDY_MESH_LEAF && !WENDY_MESH_AUTO_DISCOVER
        default ""

    config WENDY_MESH_ROUTER_PORT
        int "Router leaf listener TCP port"
        depends on WENDY_MESH_TCP
        range 1 65535
        default 43024
    config WENDY_MESH_CLOUD_UPLINK
        bool "Fall back to a mesh Internet gateway for Cloud"
        depends on WENDY_MESH_LEAF && WENDY_CLOUD && LWIP_IPV4 && LWIP_IPV6 && !LWIP_IP_FORWARD
        default n
        help
            After repeated Cloud connection failures, borrow IPv4 Internet
            through an explicitly pinned Linux mesh gateway. The gateway must
            enable shareUplink and run mesh protocol v3. Cloud TLS stays end to
            end. Existing connections may reconnect on failover and recovery.

    config WENDY_MESH_GATEWAY_DEVICE
        string "Pinned Internet gateway UUID"
        depends on WENDY_MESH_CLOUD_UPLINK
        default WENDY_MESH_ROUTER_DEVICE
endmenu
```

## components/wendy_net/Kconfig
```kconfig
menu "Wendy Networking (App-facing)"
    config WENDY_NET
        bool "Enable networking host functions"
        default n
        help
            WiFi control, BSD sockets, DNS, and TLS from WASM apps.

    config WENDY_NET_MAX_SOCKETS
        int "Max concurrent sockets"
        depends on WENDY_NET
        default 4
        range 1 256
        help
            TCP sockets consume RX + TX stream buffer space (see
            WENDY_NET_BUFFER_SIZE); UDP owns only pending packet bytes.
            Unused slots reserve only a small
            descriptor. Canonical mesh clients allocate payload storage
            after TLS setup succeeds. Must
            also fit within CONFIG_LWIP_MAX_SOCKETS at the lwIP
            layer. The raw BSD API has a separate descriptor pool of this
            same size; it retains no packet buffers and closes on guest reset.

    config WENDY_NET_MAX_LISTENERS
        int "Max concurrent listeners"
        depends on WENDY_NET
        default 1
        range 1 64

    config WENDY_NET_ACCEPT_QUEUE_SIZE
        int "Per-listener accept queue depth"
        depends on WENDY_NET
        default 1
        range 1 32
        help
            Connections queued at a listener but not yet accept()ed
            by the guest. Each queued slot also occupies one
            WENDY_NET_MAX_SOCKETS slot.

    config WENDY_NET_BUFFER_SIZE
        int "Per-socket TCP RX/TX stream buffer size (bytes)"
        depends on WENDY_NET
        default 256
        range 256 65507
        help
            TCP allocates one RX and one TX buffer of this size.
            Stream reads and writes may complete partially. This does not
            reserve maximum-sized UDP storage or limit UDP capacity.

    config WENDY_NET_DATAGRAM_MAX
        int "Maximum guest UDP datagram size (bytes)"
        depends on WENDY_NET
        default WENDY_NET_BUFFER_SIZE
        range 256 65507
        help
            UDP allocates only actual pending packet bytes, released when
            consumed or sent. This value is the maximum datagram size;
            each datagram fills one whole slot. Inbound datagrams larger
            than this are truncated (excess discarded); outbound
            datagrams larger than this are rejected (send returns an
            error) rather than truncated. The WendyLite guest's recv
            buffer must be >= this value or it will truncate datagrams.
            Full-size UDP requires a matching guest receive buffer and enough
            RAM for the configured socket pool and relay. PSRAM profiles can
            use 65507; constrained targets should measure a smaller capacity.
            Listeners peek packet lengths without a receive scratch buffer.
            Socket close and guest reset release all pending packet storage.

    config WENDY_NET_BUFFERS_IN_PSRAM
        bool "Place wendy_net buffers in PSRAM"
        depends on WENDY_NET && SPIRAM
        select SPIRAM_ALLOW_BSS_SEG_EXTERNAL_MEMORY
        default y if SPIRAM
        help
            When enabled, active socket buffers and UDP scratch are
            allocated from PSRAM, without falling back to internal RAM.
            The small socket/listener descriptor arrays use external BSS.
            Requires
            CONFIG_SPIRAM_ALLOW_BSS_SEG_EXTERNAL_MEMORY=y. Frees
            internal DRAM proportional to the configured pool
            size.
endmenu
```
