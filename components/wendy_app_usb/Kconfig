## components/wendy_app_usb/Kconfig
```kconfig
menu "Wendy App USB"
    config WENDY_APP_USB
        bool "Enable app-facing USB functions"
        default n
        help
            USB CDC and HID access from WASM apps.
            Only functional on ESP32-S2/S3 with USB OTG.
endmenu
```

## components/wendy_benchmark/Kconfig
```kconfig
menu "Wendy board benchmarks"
    config WENDY_KORVO_BENCHMARK
        bool "Run Korvo-1 memory and SIMD benchmarks at startup"
        default n
        depends on IDF_TARGET_ESP32S31
        help
            Runs bounded memory-copy and INT8 convolution benchmarks on Core 1
            ten seconds after startup, then reports heap headroom every five
            seconds while camera/audio/networking run. Requires PSRAM and
            both CPU cores; configuration fails if either is disabled.
            Output lines contain
            WENDY_BENCH followed by JSON. The convolution output is compared
            with ESP-NN's ANSI reference implementation before timing it.

            Intended for hardware qualification, not release firmware. This
            temporarily competes with application tasks and uses ESP-NN's
            global convolution scratch buffer. Do not enable in a firmware
            that runs another ESP-NN convolution user concurrently.
endmenu
```

## components/wendy_ble/Kconfig
```kconfig
menu "Wendy BLE (WendyCom transport)"
    config WENDY_BLE
        bool "Enable WendyCom over BLE"
        default y
        depends on BT_ENABLED && BT_NIMBLE_ENABLED
        help
            Serve WendyCom over mTLS over a BLE L2CAP connection-oriented
            channel. The device acts as a BLE peripheral; the console connects
            as a central.

            Enrolled devices use their PKI identity for TLS 1.3 and require
            a verified operator certificate from the same tenant.

            This component owns the NimBLE stack: it calls nimble_port_init(),
            installs the host sync callback and drives advertising. No other
            component may bring the stack up.

    config WENDY_BLE_INTERNAL_CONTROLLER_DATA
        bool "Keep native C5 HCI fragment pool in internal RAM"
        default n
        depends on WENDY_BLE && IDF_TARGET_ESP32C5 && BT_NIMBLE_MEM_ALLOC_MODE_EXTERNAL
        help
            Placement investigation: keep the dedicated HCI fragment pool
            internal while retaining the normal external host metadata policy.
            The native C5 controller receives mbufs directly. Its shared MSYS
            pools already use internal controller allocation. Host-only private
            Wendy Net SDUs remain eligible for external memory.
    config WENDY_NET_TEST_BLE_STREAM_CRC
        bool "Trace bounded mesh stream CRC checkpoints (lab only)"
        default n
        depends on WENDY_NET_BLE && WENDY_NET_TEST_DIAGNOSTICS
        help
            Compare accepted encrypted stream prefixes with a passive Bluetooth
            observer. Stores forty bytes per pipe, no payload or new task.
            Emits offsets/checksums on existing diagnostics and disconnect.

    config WENDY_BLE_PSM
        int "L2CAP PSM"
        default 128
        range 128 255
        depends on WENDY_BLE
        help
            LE PSM the L2CAP connection-oriented channel listens on. The LE
            dynamic range is 0x0080-0x00FF (128-255). The console reads the
            value from the GATT info service, so it only has to match a
            hard-coded default on platforms with no GATT support.

    config WENDY_BLE_MTU
        int "L2CAP MTU"
        default 512
        range 64 1024
        depends on WENDY_BLE
        help
            Largest SDU this device will receive. The receive ring is twice
            this size, and the transmit side uses min(this, peer MTU).

    config WENDY_BLE_REQUIRE_MTLS
        bool "Require mTLS (refuse to advertise when unenrolled)"
        default n
        depends on WENDY_BLE
        help
            When set, the device neither advertises nor opens the L2CAP server
            unless enrollment is configured. Connections need a valid stored
            device identity and a trusted operator certificate from the same
            tenant.

            When unset, an unenrolled device serves the embedded self-signed
            certificate without requiring a client certificate. Configured
            enrollment always uses PKI authentication. An unavailable PKI
            identity rejects connections.

    config WENDY_BLE_TASK_PRIORITY
        int "BLE session task priority"
        default 5
        range 1 24
        depends on WENDY_BLE

    choice WENDY_BLE_TASK_CORE_AFFINITY
        prompt "BLE session task core affinity"
        default WENDY_BLE_TASK_CORE_AFFINITY_NO_AFFINITY
        depends on WENDY_BLE
        help
            Core affinity of the wendy_ble session task.

        config WENDY_BLE_TASK_CORE_AFFINITY_CPU0
            bool "Core 0"
        config WENDY_BLE_TASK_CORE_AFFINITY_CPU1
            bool "Core 1"
            depends on !FREERTOS_UNICORE
        config WENDY_BLE_TASK_CORE_AFFINITY_NO_AFFINITY
            bool "No affinity"
    endchoice

    config WENDY_BLE_TASK_CORE_AFFINITY
        hex
        depends on WENDY_BLE
        default 0x0 if WENDY_BLE_TASK_CORE_AFFINITY_CPU0
        default 0x1 if WENDY_BLE_TASK_CORE_AFFINITY_CPU1
        default FREERTOS_NO_AFFINITY if WENDY_BLE_TASK_CORE_AFFINITY_NO_AFFINITY
endmenu
```

## components/wendy_ble_export/Kconfig
```kconfig
menu "Wendy BLE exports"
    config WENDY_BLE_EXPORT
        bool "Enable BLE host functions for WASM guests"
        default y
        depends on WENDY_BLE
        help
            BLE GAP and GATT functions exposed to WASM guests, using NimBLE.

            The NimBLE stack itself is owned and started by the wendy_ble
            component (the WendyCom BLE transport), which this depends on.
endmenu
```

## components/wendy_ble_prov/Kconfig
```kconfig
menu "Wendy BLE Provisioning"
    config WENDY_BLE_PROV
        bool "Enable BLE WiFi provisioning and discovery"
        default n
        depends on BT_ENABLED && BT_NIMBLE_ENABLED
        help
            Advertise via BLE as "Wendy-XXXX" and expose a GATT service
            that allows clients to write WiFi credentials.  Credentials
            are stored in NVS and survive reboots.

endmenu
```

## components/wendy_callback/Kconfig
```kconfig
menu "Wendy Callback Subsystem"
    config WENDY_CALLBACK
        bool "Enable callback dispatch system"
        default y
        depends on WENDY_WASM
        help
            Enable the FreeRTOS queue-based callback dispatch system.
            Required for timer callbacks, GPIO interrupts, BLE events,
            and other async operations from WASM.
endmenu
```

## components/wendy_cloud/Kconfig
```kconfig
menu "Wendy Cloud"
    config WENDY_CLOUD
        bool "Enable cloud mTLS connection"
        default n
        depends on ESP_TLS_USING_MBEDTLS
        help
            Open a persistent mTLS socket to the cloud endpoint using
            credentials provisioned by wendy_cloud_prov.

    config WENDY_CLOUD_TASK_STACK_SIZE
        int "Cloud task stack size (bytes)"
        depends on WENDY_CLOUD
        default 8192

    config WENDY_CLOUD_TASK_PRIORITY
        int "Cloud task priority"
        depends on WENDY_CLOUD
        default 5
        range 1 24

    choice WENDY_CLOUD_TASK_CORE_AFFINITY
        prompt "Cloud task core affinity"
        depends on WENDY_CLOUD
        default WENDY_CLOUD_TASK_CORE_AFFINITY_NO_AFFINITY
        help
            Core affinity of the wendy_cloud task.

        config WENDY_CLOUD_TASK_CORE_AFFINITY_CPU0
            bool "Core 0"
        config WENDY_CLOUD_TASK_CORE_AFFINITY_CPU1
            bool "Core 1"
            depends on !FREERTOS_UNICORE
        config WENDY_CLOUD_TASK_CORE_AFFINITY_NO_AFFINITY
            bool "No affinity"
    endchoice

    config WENDY_CLOUD_TASK_CORE_AFFINITY
        hex
        depends on WENDY_CLOUD
        default 0x0 if WENDY_CLOUD_TASK_CORE_AFFINITY_CPU0
        default 0x1 if WENDY_CLOUD_TASK_CORE_AFFINITY_CPU1
        default FREERTOS_NO_AFFINITY if WENDY_CLOUD_TASK_CORE_AFFINITY_NO_AFFINITY

    config WENDY_CLOUD_RECONNECT_DELAY_MS
        int "Reconnect delay (ms)"
        depends on WENDY_CLOUD
        default 5000
endmenu
```

## components/wendy_cloud_prov/Kconfig
```kconfig
menu "Wendy Cloud Provisioning"
    config WENDY_CLOUD_PROV
        bool "Enable cloud certificate provisioning via BLE"
        default n
        depends on WENDY_BLE_PROV
        help
            Expose a BLE GATT service for provisioning a device certificate,
            private key, and cloud endpoint URL. Once committed, the device
            is locked and cannot be re-provisioned without erasing NVS.

    config WENDY_CLOUD_PROV_CERT_BUF_SIZE
        int "Certificate receive buffer size (bytes)"
        depends on WENDY_CLOUD_PROV
        default 2048
        help
            Maximum size for the client certificate PEM received via BLE.

    config WENDY_CLOUD_PROV_KEY_BUF_SIZE
        int "Private key receive buffer size (bytes)"
        depends on WENDY_CLOUD_PROV
        default 2048
        help
            Maximum size for the private key PEM received via BLE.

    config WENDY_CLOUD_PROV_URL_BUF_SIZE
        int "Cloud URL buffer size (bytes)"
        depends on WENDY_CLOUD_PROV
        default 256
        help
            Maximum length of the cloud endpoint URL.
endmenu
```

## components/wendy_com/Kconfig
```kconfig
menu "Wendy Com"
    config WENDY_COM_TASK_PRIORITY
        int "Com task priority"
        default 5
        range 1 24

    choice WENDY_COM_TASK_CORE_AFFINITY
        prompt "Com task core affinity"
        default WENDY_COM_TASK_CORE_AFFINITY_NO_AFFINITY
        help
            Core affinity of the WendyCom task ("wcom").

        config WENDY_COM_TASK_CORE_AFFINITY_CPU0
            bool "Core 0"
        config WENDY_COM_TASK_CORE_AFFINITY_CPU1
            bool "Core 1"
            depends on !FREERTOS_UNICORE
        config WENDY_COM_TASK_CORE_AFFINITY_NO_AFFINITY
            bool "No affinity"
    endchoice

    config WENDY_COM_TASK_CORE_AFFINITY
        hex
        default 0x0 if WENDY_COM_TASK_CORE_AFFINITY_CPU0
        default 0x1 if WENDY_COM_TASK_CORE_AFFINITY_CPU1
        default FREERTOS_NO_AFFINITY if WENDY_COM_TASK_CORE_AFFINITY_NO_AFFINITY
endmenu
```

## components/wendy_conf/Kconfig
```kconfig
menu "Wendy Conf"
    config WENDY_DEVICE_NAME_BUF_SIZE
        int "Device name buffer size (bytes, including null terminator)"
        default 64
        help
            Size of the buffer used to hold the device name (BLE advertising
            name, mDNS hostname, etc.), including the null terminator.
            We use 64 because this corresponds to the DNS name standard.

    config WENDY_DEVICE_NAME_DEFAULT_PREFIX
        string "Default device name prefix"
        default "wendy"
        help
            Prefix used when no device name has been configured. The actual
            name is formed as "<prefix>-XXXX" where XXXX is a 4-digit hex
            number derived from the device ID.
endmenu
```

## components/wendy_display/Kconfig
```kconfig
menu "Wendy display"
    config WENDY_DISPLAY_ESP32S31_KORVO_1
        bool "Show status on the ESP32-S31-Korvo-1 LCD"
        default n
        depends on IDF_TARGET_ESP32S31 && SPIRAM
        help
            Display a native status screen on the Korvo-1 SUB3 800x480 RGB
            LCD, including uptime, free PSRAM, and Wi-Fi connection state.
            Uses one 750 KiB PSRAM framebuffer with direct DMA and a small
            background task. No LVGL or touchscreen support is required.
endmenu
```

## components/wendy_hal/Kconfig
```kconfig
menu "Wendy Hardware Abstraction Layer"
    config WENDY_HAL_GPIO
        bool "Enable GPIO HAL"
        default y

    config WENDY_HAL_I2C
        bool "Enable I2C HAL"
        default y

    config WENDY_HAL_I2C_PORT
        int "Default I2C port number"
        depends on WENDY_HAL_I2C
        default 0
        range 0 1

    config WENDY_HAL_I2C_SDA
        int "Default I2C SDA pin"
        depends on WENDY_HAL_I2C
        default 8

    config WENDY_HAL_I2C_SCL
        int "Default I2C SCL pin"
        depends on WENDY_HAL_I2C
        default 9

    config WENDY_HAL_I2C_FREQ_HZ
        int "Default I2C frequency (Hz)"
        depends on WENDY_HAL_I2C
        default 100000

    config WENDY_HAL_TIMER
        bool "Enable Timer HAL"
        default y

    config WENDY_HAL_NEOPIXEL
        bool "Enable NeoPixel (WS2812) HAL"
        default y

    config WENDY_HAL_NEOPIXEL_SPI_BACKEND
        bool
        depends on WENDY_HAL_NEOPIXEL
        default y if !SOC_RMT_SUPPORTED
        default n if SOC_RMT_SUPPORTED
        help
            Selects the led_strip SPI-MOSI backend instead of RMT for
            chips with no RMT peripheral (e.g. ESP32-C61). Not user-facing;
            picked automatically from the target's SOC_RMT_SUPPORTED cap.

    config WENDY_HAL_RMT
        bool "Enable RMT timing-buffer HAL"
        depends on SOC_RMT_SUPPORTED
        default y
        help
            Raw RMT peripheral access for precise timing waveforms
            (WS2812, IR, etc.) from WASM apps. Unavailable on chips with
            no RMT peripheral (e.g. ESP32-C61).

endmenu
```
