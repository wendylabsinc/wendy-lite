## components/wendy_otel/Kconfig
```kconfig
menu "Wendy OpenTelemetry"
    config WENDY_OTEL
        bool "Enable OpenTelemetry host functions"
        default y
        help
            In-memory logging, metrics, and tracing from WASM apps.
endmenu
```

## components/wendy_pki/Kconfig
```kconfig
menu "Wendy PKI"
    config WENDY_PKI
        bool "Use pki-core Tier C enrollment"
        default y
        select MBEDTLS_SSL_VARIABLE_BUFFER_LENGTH
        select MBEDTLS_X509_CREATE_C
        select MBEDTLS_X509_CSR_WRITE_C
        help
            Generate the identity key on-device, redeem a real pki-core credential,
            and verify signed time before making cloud mTLS connections.
    config WENDY_PKI_DEVICE_ROOTS
        string "PEM device identity trust bundle, optional build-time fallback"
        depends on WENDY_PKI
        default ""
    config WENDY_PKI_MLDSA65_SIGNING
        bool "Enable experimental own ML-DSA-65 private-key backend"
        depends on WENDY_PKI && MBEDTLS_SSL_TLS1_3_SIG_MLDSA65 && !LIBOQS_MLD_VERIFY_ONLY
        default n
        help
            Enable seed-only PKCS8 import/export, key generation and pure-message
            signing. This does not change the default P-256 enrollment key or
            enable own ML-DSA TLS/CSR/artifact publication, which need separate
            integration. Large math temporaries use the scoped crypto allocator.
    config WENDY_PKI_TSA_ROOTS
        string "PEM TSA trust bundle, optional build-time fallback"
        depends on WENDY_PKI
        default ""
    config WENDY_PKI_HTTPS_ROOTS
        string "PEM server HTTPS/TLS trust bundle, optional build-time fallback"
        depends on WENDY_PKI
        default ""
endmenu
```

## components/wendy_sensor_link/Kconfig
```kconfig
menu "Wendy SensorLink"
    config WENDY_SENSOR_LINK_XIAO_ESP32S3
        bool "Bundle XIAO ESP32S3 Sense camera and microphone"
        default n
        depends on IDF_TARGET_ESP32S3 && !WENDY_CORE_WASM_APP_SUPPORT
        help
            Expose the Seeed Studio XIAO ESP32S3 Sense expansion board's
            camera and PDM microphone through SensorLink in native firmware.
            Supports 800x600 MJPEG video and 16 kHz mono PCM audio, which can
            stream concurrently. Requires PSRAM and the Sense camera/microphone
            board.
            Other ESP32-S3 boards may use different pins and must leave this
            disabled.

    config WENDY_SENSOR_LINK_ESP32S31_KORVO_1
        bool "Bundle ESP32-S31-Korvo-1 camera and dual microphones"
        default n
        depends on IDF_TARGET_ESP32S31 && !WENDY_CORE_WASM_APP_SUPPORT
        help
            Expose the Korvo-1 V1.1 DVP camera and ES8389 microphones through
            SensorLink. Camera and audio can stream concurrently. Uses two
            PSRAM camera buffers, hardware JPEG for raw sensors, and 16 kHz
            stereo PCM audio. Requires the Korvo camera module and PSRAM;
            configuration fails if PSRAM is disabled.
    config WENDY_SENSOR_LINK_MOSAICO
        bool "Bundle ESP-Mosaico camera and microphone"
        default n
        depends on IDF_TARGET_ESP32S31 && !WENDY_CORE_WASM_APP_SUPPORT && !WENDY_SENSOR_LINK_ESP32S31_KORVO_1
        help
            Expose the left-slot Mosaico camera module as 1280x720 MJPEG
            and the onboard ES8311 microphone as 16 kHz mono PCM. Both
            streams can run concurrently. Requires PSRAM and the Mosaico
            BSP. A missing camera does not prevent microphone streaming.
endmenu
```

## components/wendy_server/Kconfig
```kconfig
menu "Wendy Server"
    config WENDY_SERVER_TASK_STACK_SIZE
        int "Server and physical TLS task stack (bytes)"
        range 15360 65536 if WENDY_NET_PEER
        range 8192 65536
        default 24576 if WENDY_PKI
        default 8192
        help
            Stack for physical management TLS and signed-time maintenance.
            Mesh carrier and VIP TLS run on the mesh actor/crypto tasks.

    config WENDY_SERVER_TASK_PRIORITY
        int "Server task priority"
        default 5
        range 1 24

    choice WENDY_SERVER_TASK_CORE_AFFINITY
        prompt "Server task core affinity"
        default WENDY_SERVER_TASK_CORE_AFFINITY_NO_AFFINITY
        help
            Core affinity of the wendy_server task.

        config WENDY_SERVER_TASK_CORE_AFFINITY_CPU0
            bool "Core 0"
        config WENDY_SERVER_TASK_CORE_AFFINITY_CPU1
            bool "Core 1"
            depends on !FREERTOS_UNICORE
        config WENDY_SERVER_TASK_CORE_AFFINITY_NO_AFFINITY
            bool "No affinity"
    endchoice

    config WENDY_SERVER_TASK_CORE_AFFINITY
        hex
        default 0x0 if WENDY_SERVER_TASK_CORE_AFFINITY_CPU0
        default 0x1 if WENDY_SERVER_TASK_CORE_AFFINITY_CPU1
        default FREERTOS_NO_AFFINITY if WENDY_SERVER_TASK_CORE_AFFINITY_NO_AFFINITY
endmenu
```

## components/wendy_spi/Kconfig
```kconfig
menu "Wendy SPI"
    config WENDY_SPI
        bool "Enable SPI host functions"
        default y
        help
            SPI master bus access from WASM apps.
endmenu
```

## components/wendy_storage/Kconfig
```kconfig
menu "Wendy Storage (NVS)"
    config WENDY_STORAGE
        bool "Enable NVS storage host functions"
        default y
        help
            NVS-backed key/value storage accessible from WASM apps.
endmenu
```

## components/wendy_sys/Kconfig
```kconfig
menu "Wendy System Functions"
    config WENDY_SYS
        bool "Enable system host functions"
        default y
        help
            System functions: uptime, reboot, firmware version,
            device ID, sleep, yield.
endmenu
```

## components/wendy_uart/Kconfig
```kconfig
menu "Wendy UART"
    config WENDY_UART
        bool "Enable UART host functions"
        default y
        help
            UART serial port access from WASM apps.
endmenu
```
